## package/go/go-bootstrap-stage2/Config.in.host
```kconfig
config BR2_PACKAGE_HOST_GO_BOOTSTRAP_STAGE2_ARCH_SUPPORTS
	bool
	default y
	depends on BR2_PACKAGE_HOST_GO_BOOTSTRAP_STAGE1_ARCH_SUPPORTS || BR2_TOOLCHAIN_GCC_AT_LEAST_10
```

## package/python-future/Config.in.host
```kconfig
config BR2_PACKAGE_HOST_PYTHON_FUTURE
	bool "host python-future"
	help
	  Easy, clean, reliable Python 2/3 compatibility.

	  http://python-future.org
```
