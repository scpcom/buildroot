## package/aic8800-sdio-firmware/Config.in
```kconfig
config BR2_PACKAGE_AIC8800_SDIO_FIRMWARE
	bool "aic8800-sdio-firmware"
	help
	  aic8800 sdio wifi mcu firmware

if BR2_PACKAGE_AIC8800_SDIO_FIRMWARE

config BR2_PACKAGE_AIC8800_SDIO_FIRMWARE_D80
	bool "aic8800-sdio-firmware-D80"
	help
	  aic8800 sdio wifi mcu firmware-D80

endif
```

## package/maix-cdk/Config.in
```kconfig
config BR2_PACKAGE_MAIX_CDK
	bool "maix-cdk"
	select BR2_PACKAGE_HOST_CMAKE
	select BR2_PACKAGE_HOST_PYTHON3
	select BR2_PACKAGE_HOST_PYTHON3_SSL
	help
	  MaixCDK.

if BR2_PACKAGE_MAIX_CDK

config BR2_PACKAGE_MAIX_CDK_MUSL_RISCV64
	bool "SDK is musl_riscv64"
	default y
	depends on BR2_RISCV_64 && BR2_RISCV_ISA_RVI && BR2_RISCV_ISA_RVM && \
			BR2_RISCV_ISA_RVA && BR2_RISCV_ISA_RVF && \
			BR2_RISCV_ISA_RVD && BR2_RISCV_ISA_RVC && \
			BR2_TOOLCHAIN_USES_MUSL
	help
	  SDK is musl_riscv64.

config BR2_PACKAGE_MAIX_CDK_ALL_DEPENDENCIES
	bool "All MaixCDK dependencies"
	default y
	select BR2_PACKAGE_ALSA_LIB
	select BR2_PACKAGE_FFMPEG
	select BR2_PACKAGE_HARFBUZZ
	select BR2_PACKAGE_LIBXML2
	select BR2_PACKAGE_OPENCV4
	select BR2_PACKAGE_XZ
	help
	  Include all MaixCDK dependencies.

endif

if BR2_PACKAGE_MAIX_CDK_ALL_DEPENDENCIES

config BR2_PACKAGE_MAIX_CDK_ALL_PROJECTS
	bool "All MaixCDK projects"
	default y
	help
	  Build all MaixCDK projects.

config BR2_PACKAGE_MAIX_CDK_ALL_EXAMPLES
	bool "All MaixCDK examples"
	default n
	help
	  Build all MaixCDK examples.

config BR2_PACKAGE_MAIX_CDK_KEEP_MAIXCAM_LIB
	bool "Keep pre-built maixcam_lib"
	default n
	depends on BR2_PACKAGE_MAIX_CDK_MUSL_RISCV64
	help
	  Build with pre-built maixcam_lib.
	  Uses closed-source libs.

config BR2_PACKAGE_MAIX_CDK_NN_TPU
	bool "Enable NN/TPU support"
	default n
	depends on BR2_PACKAGE_MAIX_CDK_MUSL_RISCV64
	depends on BR2_PACKAGE_SOPHGO_LIBRARY
	help
	  Build with NN/TPU support.
	  Uses closed-source libs.

endif
```

## package/maix-py/Config.in
```kconfig
config BR2_PACKAGE_MAIX_PY
	bool "maix-py"
	depends on BR2_PACKAGE_MAIX_CDK
	select BR2_PACKAGE_MAIX_CDK_ALL_DEPENDENCIES
	select BR2_PACKAGE_MAIX_CDK_ALL_PROJECTS
	help
	  MaixPy.

if BR2_PACKAGE_MAIX_PY

config BR2_PACKAGE_MAIX_PY_ALL_PROJECTS
	bool "All MaixPy projects"
	default y
	help
	  Build all MaixPy projects.

config BR2_PACKAGE_MAIX_PY_ALL_EXAMPLES
	bool "All MaixPy examples"
	default n
	help
	  Build all MaixPy examples.

endif
```

## package/maixcam-sg200x/Config.in
```kconfig
config BR2_PACKAGE_MAIXCAM_SG200X
	bool "maixcam-sg200x"
	depends on BR2_PACKAGE_MAIX_CDK
	help
	  maixcam apps for sg200x
```

## package/mavlink-router/Config.in
```kconfig
config BR2_PACKAGE_MAVLINK_ROUTER
	bool "Mavlink router"

	help
	  JMAVLink Router is an application to distribute MAVLink messages 
	  between multiple endpoints (connections). It distributes packets 
	  to a single port or multiple endpoints depending on the target address.

	  https://github.com/mavlink-router/mavlink-router
```

## package/mavlink/Config.in
```kconfig
config BR2_PACKAGE_MAVLINK
	bool "mavlink"
	select BR2_PACKAGE_LIBXML2
	select BR2_PACKAGE_PYTHON3
	select BR2_PACKAGE_PYTHON_FUTURE
	select BR2_PACKAGE_PYTHON_LXML
	help
	  MAVLink micro air vehicle marshalling / communication library.

	  https://mavlink.io/
```

## package/mavproxy/Config.in
```kconfig
config BR2_PACKAGE_MAVPROXY
	bool "Mavproxy"
	select BR2_PACKAGE_PYTHON3
	select BR2_PACKAGE_PYMAVLINK
	select BR2_PACKAGE_PYTHON_NUMPY
	select BR2_PACKAGE_PYTHON_SERIAL
	help
	  This is a MAVLink ground station written in python.

	  https://ardupilot.org/mavproxy/index.html
```

## package/overlayfs-tools/Config.in
```kconfig
config BR2_PACKAGE_OVERLAYFS_TOOLS
	bool "overlayfs-tools"
	help
	  OverlayFS tools

	  https://github.com/kmxz/overlayfs-tools/
```

## package/pymavlink/Config.in
```kconfig
config BR2_PACKAGE_PYMAVLINK
	bool "Pymavlink"
	select BR2_PACKAGE_LIBXML2
	select BR2_PACKAGE_MAVLINK
	select BR2_PACKAGE_PYTHON3
	select BR2_PACKAGE_PYTHON_FUTURE
	select BR2_PACKAGE_PYTHON_LXML
	help
	  python MAVLink interface and utilities.

	  https://ardupilot.org/dev/docs/mavlink-commands.html
```

## package/python-maixtool/Config.in
```kconfig
config BR2_PACKAGE_PYTHON_MAIXTOOL
	bool "python-maixtool"
	select BR2_PACKAGE_PYTHON_FLASK
	select BR2_PACKAGE_PYTHON_NETIFACES
	select BR2_PACKAGE_PYTHON_PILLOW
	select BR2_PACKAGE_PYTHON_PYYAML
	select BR2_PACKAGE_PYTHON_PROGRESS
	select BR2_PACKAGE_PYTHON_QRCODE
	select BR2_PACKAGE_PYTHON_REQUESTS
	help
	  Tools for MaixPy and MaixCDK.

	  https://github.com/Sipeed/MaixCDK
```

## package/python-markdown-it-py/Config.in
```kconfig
config BR2_PACKAGE_PYTHON_MARKDOWN_IT_PY
	bool "python-markdown-it-py"
	select BR2_PACKAGE_PYTHON_MDURL
	help
	  Tools for MaixPy and MaixCDK.

	  https://github.com/Sipeed/MaixCDK
```

## package/python-mdit-py-plugins/Config.in
```kconfig
config BR2_PACKAGE_PYTHON_MDIT_PY_PLUGINS
	bool "python-mdit-py-plugins"
	select BR2_PACKAGE_PYTHON_MARKDOWN_IT_PY
	help
	  Tools for MaixPy and MaixCDK.

	  https://github.com/Sipeed/MaixCDK
```

## package/python-mdurl/Config.in
```kconfig
config BR2_PACKAGE_PYTHON_MDURL
	bool "python-mdurl"
	help
	  Tools for MaixPy and MaixCDK.

	  https://github.com/Sipeed/MaixCDK
```

## package/python-platformdirs/Config.in
```kconfig
config BR2_PACKAGE_PYTHON_PLATFORMDIRS
	bool "python-platformdirs"
	help
	  Tools for MaixPy and MaixCDK.

	  https://github.com/Sipeed/MaixCDK
```

## package/python-progress/Config.in
```kconfig
config BR2_PACKAGE_PYTHON_PROGRESS
	bool "python-progress"
	help
	  Easy progress reporting for Python.

	  https://github.com/verigak/progress/
```

## package/python-rich/Config.in
```kconfig
config BR2_PACKAGE_PYTHON_RICH
	bool "python-rich"
	select BR2_PACKAGE_PYTHON_MARKDOWN_IT_PY
	select BR2_PACKAGE_PYTHON_PYGMENTS
	help
	  Tools for MaixPy and MaixCDK.

	  https://github.com/Sipeed/MaixCDK
```

## package/python-textual/Config.in
```kconfig
config BR2_PACKAGE_PYTHON_TEXTUAL
	bool "python-textual"
	select BR2_PACKAGE_PYTHON_MARKDOWN_IT_PY
	select BR2_PACKAGE_PYTHON_MDIT_PY_PLUGINS
	select BR2_PACKAGE_PYTHON_PLATFORMDIRS
	select BR2_PACKAGE_PYTHON_PYGMENTS
	select BR2_PACKAGE_PYTHON_RICH
	select BR2_PACKAGE_PYTHON_TYPING_EXTENSIONS
	select BR2_PACKAGE_PYTHON_ZIPP
	help
	  Build cross-platform user interfaces with a simple Python API.

	  https://github.com/Textualize/textual
```

## package/python-zipp/Config.in
```kconfig
config BR2_PACKAGE_PYTHON_ZIPP
	bool "python-zipp"
	help
	  Tools for MaixPy and MaixCDK.

	  https://github.com/Sipeed/MaixCDK
```
